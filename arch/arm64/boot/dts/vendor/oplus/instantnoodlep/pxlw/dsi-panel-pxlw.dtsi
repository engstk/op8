// SPDX-License-Identifier: GPL-2.0-only
/*
 * Copyright (c) 2020, Pixelworks
 */

&dsi_oplus19811_samsung_1440_3168_dsc_cmd {
	pxlw,iris-chip-enable;
	pxlw,soft-iris-enable;
	qcom,iris-supply-entries = <&dsi_iris_pwr_supply>;
	qcom,dsi-select-clocks = "mux_byte_clk0", "mux_pixel_clk0", "pw_bb_clk2";
};

&mdss_mdp {
	pxlw,dsi-display-primary-active = "qcom,mdss_dsi_oppo19811_samsung_1440_3168_dsc_cmd";
};
