## drivers/soc/oplus/thermal/Kconfig
```kconfig
#
# Generic thermal sysfs drivers configuration
#

config HORAE_THERMAL_SHELL
	  tristate "Horae shell temp driver"
	  default y
	  help
	    Provide three thermal zones(front, frame and back) to get real shell temp.

#ifdef OPLUS_FEATURE_GKI_CPUFREQ_BOUNCING
source "drivers/soc/oplus/thermal/cpufreq_bouncing/Kconfig"
#endif /* OPLUS_FEATURE_GKI_CPUFREQ_BOUNCING */

#ifdef CONFIG_OPLUS_FEATURE_ATD
source "drivers/soc/oplus/thermal/detection/Kconfig"
#endif
```

## drivers/soc/oplus/thermal/detection/Kconfig
```kconfig
config OPLUS_FEATURE_ATD
	tristate "abnormal_detection"
	default n
	help
	  abnormal thread detection
```

## drivers/soc/oplus/thermal/oplus_omrg/Kconfig
```kconfig
config OPLUS_OMRG
  tristate "oplus multiple rail group"
  default n
  help
    manager frequency dependency caused by multiple rail between
    different cpufreq device and devfreq device
```

## drivers/soc/oplus/tpd/Kconfig
```kconfig
# SPDX-License-Identifier: GPL-2.0-only
# Copyright (C) 2018-2020 Oplus. All rights reserved.

config OPLUS_FEATURE_TPD
	default n
	bool "a task placement decision for cpu limitation"
	help
	 task placement decision feature
```

## fs/proc/cpu_jankinfo/Kconfig
```kconfig
config OPLUS_FEATURE_CPU_JANKINFO
	tristate "config cpu_jankinfo"
	default n
	help
	  define this config to enable cpu jankinfo.
```

## fs/proc/healthinfo/Kconfig
```kconfig
#ifdef OPLUS_FEATURE_HEALTHINFO
config FG_TASK_UID
	bool "Enable /proc/fg_info/ if EXPERT"
	default y
	help
	  Add foreground process optimize support to promote performance .
#endif
#ifdef OPLUS_FEATURE_HEALTHINFO
config OPLUS_JANK_INFO
	bool "Enable /proc/pid/jank_info if EXPERT"
	default n
	help
	  Add jank monitor opt support .
#endif
```

## fs/proc/task_cpustats/Kconfig
```kconfig
config OPLUS_CTP
	tristate "task_cpustats"
	default n
	help
	  record cpu status

config OPLUS_SCHED
	tristate "task_sched_info"
	default n
	help
	  record task sched info

config UTILS_MONITOR
        tristate "task_load"
        default n
        help
          record task load

config OPLUS_GPU_FREQ_TRACE_POINT
	tristate "msm_kgsl"
	default n
	help
	  change kgsl gpu frequency trace point
```

## include/linux/tpp/Kconfig
```kconfig
config OPLUS_FEATURE_TPP
	bool "Support for TPP"
	default n
	help
	  This feature is developed for optimizing unity game which have multi workerthread
```

## kernel/sched_assist/Kconfig
```kconfig
config OPLUS_FEATURE_SCHED_ASSIST
	tristate "sched_assist"
	default n
	help
	  turning sched for ui, render and so on to improve UX
config OPLUS_FEATURE_SCHED_SPREAD
	bool "sched_spread"
	default n
	help
	  This is the uifirst 5.0 feature, which will spread tasks,
	  kick runnable time from task demand and adjust bg's time slice.
config OPLUS_UX_IM_FLAG
	bool "config ux im_flag"
	default n
	help
	  export im_flag proc node for mark thread.
config OPLUS_RELEASE_BUFFER_CALLBACK_UX
	bool "config launcher async release buffer callback ux"
	default n
	help
	  the binder thread of launcher which response async release buffer
	  callback from sf is set to UX from ONCE_UX.
config OPLUS_FEATURE_AUDIO_OPT
	bool "config audio opt"
	default n
	help
	  audio task schedule opt.
config OPLUS_CRTC_COMMIT_MUTEX_OPT
	bool "config crtc_commit mutex opt"
	default n
	help
	  crtc_commit thread and CFS thread frequently compete for mutex
	  lock optimization.
```

## kernel/special_opt/Kconfig
```kconfig
config OPLUS_FEATURE_UIFRIST_HEAVYLOAD
	tristate "cpu sched for heavy load process"
	default y
	---help---
	  cpu sched for heavy load process.
```

## kernel/tuning/Kconfig
```kconfig
config OPLUS_FEATURE_INPUT_BOOST_V4
        bool "config input boost"
        depends on SCHED_WALT
        default n
        help
          track load of all ux tasks,opt task placement and frequency selection
```

## mm/healthinfo/Kconfig
```kconfig
#ifdef OPLUS_FEATURE_HEALTHINFO
config OPLUS_MEM_MONITOR
	bool "memory monitor "
	default n
	help
	 memory monitor.
#endif /* OPLUS_FEATURE_HEALTHINFO */
```

## mm/malloc_track/Kconfig
```kconfig
# SPDX-License-Identifier: GPL-2.0-only
# Copyright (C) 2018-2020 Oplus. All rights reserved.

config OPLUS_MEMLEAK_DETECT
	string
	default "$(OPLUS_MEMLEAK_DETECT)"

config KMALLOC_DEBUG
	default n
	bool "Enable Create kmalloc caches with debug flag"
	depends on STACKTRACE && SLUB_DEBUG
	help
	  If kmalloc-* slab has memleak, will replace the kmalloc cache
	  with a new kmalloc debug cache. The new kmalloc cache will enable
	  SLAB_STORE_USER.

source "mm/malloc_track/Kconfig.in"
```

## mm/malloc_track/Kconfig.in
```kconfig
# SPDX-License-Identifier: GPL-2.0-only
# Copyright (C) 2018-2020 Oplus. All rights reserved.

config VMALLOC_DEBUG
	bool "trace vmalloc called information with a stack"
	default n
	help
	  trace vmalloc called information with a stack.

config MEMLEAK_DETECT_THREAD
	bool "One kernel thread to detect memleak and dump infomation to log"
	depends on (KMALLOC_DEBUG || VMALLOC_DEBUG) && SVELTE
	default y if OPLUS_MEMLEAK_DETECT="true"
	default n
	help
	  a daemon to monitor kernel memory leak.
```

## mm/memory_isolate/Kconfig
```kconfig
# SPDX-License-Identifier: GPL-2.0-only
# Copyright (C) 2018-2020 Oplus. All rights reserved.

config OPLUS_MEMORY_ISOLATE
       bool "Enable memory isolate to anti fragment"
       depends on !CONFIG_VMAP_STACK
       default n
       help
        Isolate memory to anti fragment.
```

## mm/multi_kswapd/Kconfig
```kconfig
# SPDX-License-Identifier: GPL-2.0-only
# Copyright (C) 2018-2020 Oplus. All rights reserved.

config OPLUS_MULTI_KSWAPD
       bool "Enable multi kswapd"
       default n
       help
         multi kswapd

config KSWAPD_UNBIND_MAX_CPU
       bool "kswapd unbind to max capacity cpu"
       default n
       depends on OPLUS_MULTI_KSWAPD
       help
         unbind to max capacity cpu
```

## mm/task_mem/Kconfig
```kconfig
# SPDX-License-Identifier: GPL-2.0-only
# Copyright (C) 2018-2020 Oplus. All rights reserved.

config DUMP_TASKS_MEM
	bool "dump all userspace process meminfo"
	default n
	help
	  dump all userspace process meminfo

config DUMP_MM_INFO
	bool "dump all userspace process meminfo"
	default n
	help
	  dump all userspace process meminfo
```

## net/oplus_modules/Kconfig
```kconfig
# SPDX-License-Identifier: GPL-2.0-only
# Copyright (C) 2018-2020 Oplus. All rights reserved.

source "net/oplus_modules/oplus_dns_hook/Kconfig"

source "net/oplus_modules/oplus_stats_calc/Kconfig"

source "net/oplus_modules/oplus_qr_scan/Kconfig"
```

## net/oplus_modules/oplus_apps_monitor/Kconfig
```kconfig
# SPDX-License-Identifier: GPL-2.0-only
# Copyright (C) 2020-2022 Oplus. All rights reserved.

config OPLUS_FEATURE_APP_MONITOR
        tristate "Add for oplus app monitor function"
        help
          Add for oplus app monitor function.
```

## net/oplus_modules/oplus_dns_hook/Kconfig
```kconfig
# PDX-License-Identifier: GPL-2.0-only
# Copyright (C) 2020-2022 Oplus. All rights reserved.

config OPLUS_FEATURE_DNS_HOOK
        tristate "Add for quick app support dns hook"
        help
          Add for quick app support dns hook
```

## net/oplus_modules/oplus_qr_scan/Kconfig
```kconfig
# SPDX-License-Identifier: GPL-2.0-only
# Copyright (C) 2020-2022 Oplus. All rights reserved.

config OPLUS_FEATURE_QR_SCAN
        tristate "Add for qr scan"
        help
          Add for Add for tqr scan
```

## net/oplus_modules/oplus_stats_calc/Kconfig
```kconfig
# SPDX-License-Identifier: GPL-2.0-only
# Copyright (C) 2020-2022 Oplus. All rights reserved.

config OPLUS_FEATURE_STATS_CALC
        tristate "Add for iface uid stats"
        help
          Add for iface uid stats.
```
