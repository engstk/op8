/dts-v1/;
/plugin/;

#include <dt-bindings/clock/qcom,gcc-kona.h>
#include <dt-bindings/clock/qcom,camcc-kona.h>
#include <dt-bindings/clock/qcom,rpmh.h>
#include <dt-bindings/interrupt-controller/arm-gic.h>

#include "kebab/kona-mtp.dtsi"
#include "kebab/kona-camera-sensor.dtsi"

/ {
	model = "Qualcomm Technologies, Inc. kona MTP 19805 20809";
	compatible = "qcom,kona-mtp", "qcom,kona", "qcom,mtp";
	qcom,board-id = <0x10008 0>;
	oplus,dtsi_no = <19805 20809>;
	oplus,pcb_range = <0 56>;
};

