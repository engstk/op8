/dts-v1/;

#include "../qcom/kona-v2.dtsi"
#include "kona.dtsi"

/ {
	model = "Qualcomm Technologies, Inc. kona v2 SoC";
	compatible = "qcom,kona";
	qcom,board-id = <0 0>;
	oplus,dtsi_no = <19805 19811 19821 19855 20809 20828>;
	oplus,pcb_range = <0 56>;
};
