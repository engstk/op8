/**********************************************************************************
* Copyright (c)  2008-2022  Guangdong oplus Mobile Comm Corp., Ltd
* Description: oplus pn557 nfc dtsi
*
* Version: 1.0
* Date: 2022-03-10
* Author: huangtengming
*
* ------------------------------ Revision History: --------------------------------
* <version>           <date>                <author>                            <desc>
* Revision 1.0       2022-03-10            huangtengming           Created for  pn557 nfc dtsi
***********************************************************************************/
&soc {
	//add for nfc_chipset
	nfc_chipset {
		compatible = "oplus-nfc-chipset";
		chipset-20813 = "PN557";
		chipset-20814 = "PN557";
	};
};



&qupv3_se8_i2c {
	status = "ok";
	#address-cells = <1>;
	#size-cells = <0>;
	nq@28 {
		compatible = "nxp,pn544";
		reg = <0x28>;
		nxp,pn544-irq = <&tlmm 9 0x00>;
		nxp,pn544-ven = <&tlmm 6 0x00>;
		nxp,pn544-fw-dwnld = <&tlmm 8 0x00>;
		interrupt-parent = <&tlmm>;
		interrupts = <9 0>;
		interrupt-names = "nfc_irq";
		pinctrl-names = "nfc_active", "nfc_suspend";
		pinctrl-0 = <&nfc_int_active &nfc_enable_active
				&nfc_clk_req_active>;
		pinctrl-1 = <&nfc_int_suspend &nfc_enable_suspend
				&nfc_clk_req_suspend>;
	};
};