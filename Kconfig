## Kconfig
```kconfig
# SPDX-License-Identifier: GPL-2.0
#
# For a description of the syntax of this configuration file,
# see Documentation/kbuild/kconfig-language.txt.
#
mainmenu "Linux/$(ARCH) $(KERNELVERSION) Kernel Configuration"

#ifdef CONFIG_OPLUS_SYSTEM_KERNEL
config OPLUS_SYSTEM_KERNEL_QCOM
  bool "config oplus system feature "
  default y
  help
	define this config to Distinguish between qcom and mtk platform

config OPLUS_SYSTEM_KERNEL_MTK
  bool "config oplus system feature "
  default n
  help
	define this config to Distinguish between qcom and mtk platform
#endif /*CONFIG_OPLUS_SYSTEM_KERNEL*/

source "scripts/Kconfig.include"

source "init/Kconfig"

source "kernel/Kconfig.freezer"

source "fs/Kconfig.binfmt"

source "mm/Kconfig"

source "net/Kconfig"

source "drivers/Kconfig"

source "fs/Kconfig"

source "security/Kconfig"

source "crypto/Kconfig"

source "lib/Kconfig"

source "lib/Kconfig.debug"

source "techpack/Kconfig"
```

## block/uxio_first/Kconfig
```kconfig
# SPDX-License-Identifier: GPL-2.0-only
# Copyright (C) 2018-2020 Oplus. All rights reserved.

config OPLUS_FEATURE_UXIO_FIRST
	bool "Support for ux io first opt"
	default y
	help
	  Enable ux io first opt.
```

## drivers/block/zram/zwb_handle/Kconfig
```kconfig
# SPDX-License-Identifier: GPL-2.0-only

config ZWB_HANDLE
  tristate "handle for specific processes"
  depends on ZRAM_WRITEBACK
  default n
  help
    handle for specific processes.
```

## drivers/input/oplus_fp_drivers/Kconfig
```kconfig
menuconfig OPLUS_FINGERPRINT
	bool "OPLUS fingerprint"
	depends on SPI_MASTER
	help
	  Say Y here to enable OPLUS fingerprint support

config OPLUS_FINGERPRINT_GKI_DISABLE
	default n
	tristate "Fingerprint enable gki"

if OPLUS_FINGERPRINT
### platform config
config OPLUS_FINGERPRINT_QCOM
	default n
	tristate "Fingerprint base on QCOM"

### fingerprint sensor config
config OPLUS_FINGERPRINT_GOODIX_OPTICAL
	default n
	tristate "Fingerprint base on goodix optical chip"

config OPLUS_FINGERPRINT_JIIOV_OPTICAL
	default n
	tristate "Fingerprint base on jiiov optical chip"
endif #OPLUS_FINGERPRINT
```

## drivers/input/oplus_secure_drivers/Kconfig
```kconfig
### secure common config
config OPLUS_SECURE
       default n
       tristate "Secure driver"

config OPLUS_SECURE_COMMON
       default n
       tristate "Secure common"

config OPLUS_SECURE_QCOM
       default n
       tristate "Secure base on QCOM"

config OPLUS_SECURE_MTK
       default n
       tristate "Secure base on MTK"
config QCOM_QSEELOG_ENCRYPT
       default n
       tristate "Qsee log encrypt"
```

## drivers/input/touchscreen/oplus_touchscreen/Focal/FT8006/Kconfig
```kconfig
#ifdef OPLUS_FEATURE_TP_BASIC


config TOUCHPANEL_FOCAL_FT8006
#	default y
	bool "TP focal_ft8006 IC enable or not for OPLUS"
	---help---
	say Y to enable driver for Touchpanel useing focal ft8006

#endif
```

## drivers/input/touchscreen/oplus_touchscreen/Focal/Kconfig
```kconfig
source "drivers/input/touchscreen/oplus_touchscreen/Focal/FT8006/Kconfig"
source "drivers/input/touchscreen/oplus_touchscreen/Focal/ft3518/Kconfig"
source "drivers/input/touchscreen/oplus_touchscreen/Focal/ft8006s_aa/Kconfig"
source "drivers/input/touchscreen/oplus_touchscreen/Focal/ft3681/Kconfig"
```

## drivers/input/touchscreen/oplus_touchscreen/Focal/ft3518/Kconfig
```kconfig
config TOUCHPANEL_FOCAL_FT3518
	bool "TP Focal_FT3518 IC enable or not for OPLUS"
	---help---
	say Y to enable driver for Touchpanel using Focal FT3518
```

## drivers/input/touchscreen/oplus_touchscreen/Focal/ft3681/Kconfig
```kconfig
config TOUCHPANEL_FOCAL_FT3681
	tristate "TP focal ft3681 IC enable or not for OPLUS"
	help
	Say Y to enable driver for Touchpanel using Focal FT3681
	Say M to enable driver for Touchpanel using Focal FT3681 as module
```

## drivers/input/touchscreen/oplus_touchscreen/Focal/ft8006s_aa/Kconfig
```kconfig
config TOUCHPANEL_FOCAL_FT8006S_AA
	bool "TP Focal_FT8006S_AA IC enable or not for OPLUS"
	---help---
	say Y to enable driver for Touchpanel using Focal FT8006S-AA
```

## drivers/input/touchscreen/oplus_touchscreen/Goodix/GT9286/Kconfig
```kconfig
#ifdef OPLUS_FEATURE_TP_BASIC


config TOUCHPANEL_GOODIX_GT9286
#   default y
    bool "TP goodix gt9286 IC enable or not for OPLUS"
    ---help---
    say Y to enable driver for Touchpanel useing goodix gt9286

#endif
```

## drivers/input/touchscreen/oplus_touchscreen/Goodix/Kconfig
```kconfig
source "drivers/input/touchscreen/oplus_touchscreen/Goodix/Goodix_gt5688/Kconfig"
source "drivers/input/touchscreen/oplus_touchscreen/Goodix/GT9286/Kconfig"
source "drivers/input/touchscreen/oplus_touchscreen/Goodix/GT9886/Kconfig"
```

## drivers/input/touchscreen/oplus_touchscreen/Himax/Kconfig
```kconfig
source "drivers/input/touchscreen/oplus_touchscreen/Himax/hx83112b/Kconfig"
source "drivers/input/touchscreen/oplus_touchscreen/Himax/hx83112a_noflash/Kconfig"
source "drivers/input/touchscreen/oplus_touchscreen/Himax/hx83112b_noflash/Kconfig"
source "drivers/input/touchscreen/oplus_touchscreen/Himax/hx83102d_noflash/Kconfig"
source "drivers/input/touchscreen/oplus_touchscreen/Himax/hx83112f_noflash/Kconfig"
```

## drivers/input/touchscreen/oplus_touchscreen/Himax/hx83102d_noflash/Kconfig
```kconfig
#ifdef OPLUS_FEATURE_TP_BASIC


config TOUCHPANEL_HIMAX_HX83102D_NOFLASH
#	default y
	bool "TP himax hx83102d no-flash IC enable or not for OPLUS"
	---help---
	say Y to enable driver for Touchpanel useing himax hx83102d no-flash

#endif
```

## drivers/input/touchscreen/oplus_touchscreen/Himax/hx83112a_noflash/Kconfig
```kconfig
#ifdef OPLUS_FEATURE_TP_BASIC


config TOUCHPANEL_HIMAX_HX83112A_NOFLASH
#	default y
	bool "TP himax hx83112a no-flash IC enable or not for OPLUS"
	---help---
	say Y to enable driver for Touchpanel useing himax hx83112a no-flash

#endif
```

## drivers/input/touchscreen/oplus_touchscreen/Himax/hx83112b/Kconfig
```kconfig
#ifdef OPLUS_FEATURE_TP_BASIC


config TOUCHPANEL_HIMAX_HX83112B
#	default y
	bool "TP himax hx83112b IC enable or not for OPLUS"
	---help---
	say Y to enable driver for Touchpanel useing himax hx83112b

#endif
```

## drivers/input/touchscreen/oplus_touchscreen/Himax/hx83112b_noflash/Kconfig
```kconfig
#ifdef OPLUS_FEATURE_TP_BASIC


config TOUCHPANEL_HIMAX_HX83112B_NOFLASH
#	default y
	bool "TP himax hx83112b no-flash IC enable or not for OPLUS"
	---help---
	say Y to enable driver for Touchpanel useing himax hx83112b no-flash

#endif
```

## drivers/input/touchscreen/oplus_touchscreen/Himax/hx83112f_noflash/Kconfig
```kconfig
#ifdef OPLUS_FEATURE_TP_BASIC


config TOUCHPANEL_HIMAX_HX83112F_NOFLASH
#	default y
	bool "TP himax hx83112f no-flash IC enable or not for OPLUS"
	---help---
	say Y to enable driver for Touchpanel useing himax hx83112a no-flash

#endif
```

## drivers/input/touchscreen/oplus_touchscreen/Kconfig
```kconfig
config TOUCHPANEL_LATE_INIT
	bool "mk6360 pmic init"
	help
	  Say Y here if you have mk6360 pmic.

config TOUCHIRQ_UPDATE_QOS
	bool "OPLUS touchpanel driver update qos"
	help
	  Say Y here if you want to update qos value in irq handler.

config TOUCHPANEL_NEW_SET_IRQ_WAKE
	bool "OPLUS platform tp module used"
	help
	  Say Y here if call enable_irq_wake, can not call disable_irq_nosync

config TOUCHPANEL_OPLUS
	bool "OPLUS tp module"
	help
	  Say Y here if you have touchscreen module.

config OPLUS_TP_APK
	bool "OPLUS apk node create"
	help
	  Say Y here if you use apk for TP.

config TOUCHPANEL_SAMSUNG
	bool "TP samsung IC enable or not for OPLUS"
	---help---
	  say Y to enable driver for Touchpanel using samsung IC

config TOUCHPANEL_SYNAPTICS
	bool "TP Synaptics_IC enable or not for OPLUS"
	help
	  say Y to enable driver for Touchpanel using Synaptics_IC

if TOUCHPANEL_SAMSUNG
source "drivers/input/touchscreen/oplus_touchscreen/Samsung/Kconfig"
endif

if TOUCHPANEL_SYNAPTICS
source "drivers/input/touchscreen/oplus_touchscreen/Synaptics/Kconfig"
endif
```

## drivers/input/touchscreen/oplus_touchscreen/Novatek/Kconfig
```kconfig
config TOUCHPANEL_NT_DIGITALNOISE_TEST
#   default y
    bool "TP nova nt36672C IC add digital noise test or not for OPLUS"
    ---help---
    say Y to add digital noise test
config TOUCHPANEL_NT_PEN_SUPPORT
	default y
	bool "Stylus support or not for Novatek Touch Panel Driver"
	---help---
	say Y to enable stylus function Novatek Touchpanel
	
source "drivers/input/touchscreen/oplus_touchscreen/Novatek/NT36672/Kconfig"
source "drivers/input/touchscreen/oplus_touchscreen/Novatek/NT36525/Kconfig"
source "drivers/input/touchscreen/oplus_touchscreen/Novatek/NT36672_noflash/Kconfig"
source "drivers/input/touchscreen/oplus_touchscreen/Novatek/NT36525_noflash/Kconfig"
source "drivers/input/touchscreen/oplus_touchscreen/Novatek/NT36525B_noflash/Kconfig"
source "drivers/input/touchscreen/oplus_touchscreen/Novatek/NT36672C_noflash/Kconfig"
source "drivers/input/touchscreen/oplus_touchscreen/Novatek/NT36523_noflash/Kconfig"
```

## drivers/input/touchscreen/oplus_touchscreen/Novatek/NT36523_noflash/Kconfig
```kconfig
#ifdef OPLUS_FEATURE_TP_BASIC
config TOUCHPANEL_NOVA_NT36523_NOFLASH
#	default y
	bool "TP nova nt36523 IC enable or not for OPLUS"
	---help---
	say Y to enable driver for Touchpanel useing nova nt36523
#endif
```

## drivers/input/touchscreen/oplus_touchscreen/Novatek/NT36525/Kconfig
```kconfig
#ifdef OPLUS_FEATURE_TP_BASIC


config TOUCHPANEL_NOVA_NT36525
#	default y
	bool "TP nova nt36525 IC enable or not for OPLUS"
	---help---
	say Y to enable driver for Touchpanel useing nova nt36525

#endif
```

## drivers/input/touchscreen/oplus_touchscreen/Novatek/NT36525B_noflash/Kconfig
```kconfig
config TOUCHPANEL_NOVA_NT36525B_NOFLASH
#	default y
	bool "TP nova nt36525B IC enable or not for OPLUS"
	---help---
	say Y to enable driver for Touchpanel useing nova nt36525B
```

## drivers/input/touchscreen/oplus_touchscreen/Novatek/NT36525_noflash/Kconfig
```kconfig
config TOUCHPANEL_NOVA_NT36525_NOFLASH
#	default y
	bool "TP nova nt36525 IC enable or not for OPLUS"
	---help---
	say Y to enable driver for Touchpanel useing nova nt36525

#endif
```

## drivers/input/touchscreen/oplus_touchscreen/Novatek/NT36672/Kconfig
```kconfig
#ifdef OPLUS_FEATURE_TP_BASIC


config TOUCHPANEL_NOVA_NT36672
#	default y
	bool "TP nova nt36672 IC enable or not for OPLUS"
	---help---
	say Y to enable driver for Touchpanel useing nova nt36672

#endif
```
