## drivers/input/touchscreen/oplus_touchscreen/Novatek/NT36672C_noflash/Kconfig
```kconfig
config TOUCHPANEL_NOVA_NT36672C_NOFLASH
#	default y
	bool "TP nova nt36672C IC enable or not for OPLUS"
	---help---
	say Y to enable driver for Touchpanel useing nova nt36672
```

## drivers/input/touchscreen/oplus_touchscreen/Samsung/Kconfig
```kconfig
source "drivers/input/touchscreen/oplus_touchscreen/Samsung/S6SY791/Kconfig"
source "drivers/input/touchscreen/oplus_touchscreen/Samsung/S6SY792/Kconfig"
source "drivers/input/touchscreen/oplus_touchscreen/Samsung/S6SY761/Kconfig"
source "drivers/input/touchscreen/oplus_touchscreen/Samsung/S6D7AT0/Kconfig"
source "drivers/input/touchscreen/oplus_touchscreen/Samsung/S6SY771/Kconfig"
```

## drivers/input/touchscreen/oplus_touchscreen/Samsung/S6D7AT0/Kconfig
```kconfig
#ifdef OPLUS_FEATURE_TP_BASIC


config TOUCHPANEL_SAMSUNG_S6D7AT0
#	default y
	bool "TP Samsung s6sy761 IC enable or not for OPLUS"
	---help---
	say Y to enable driver for Touchpanel using Samsung s6d7at0

#endif
```

## drivers/input/touchscreen/oplus_touchscreen/Samsung/S6SY761/Kconfig
```kconfig
#ifdef OPLUS_FEATURE_TP_BASIC


config TOUCHPANEL_SAMSUNG_S6SY761
#	default y
	bool "TP Samsung s6sy761 IC enable or not for OPLUS"
	---help---
	say Y to enable driver for Touchpanel using Samsung s6sy761

#endif
```

## drivers/input/touchscreen/oplus_touchscreen/Samsung/S6SY771/Kconfig
```kconfig
config TOUCHPANEL_SAMSUNG_S6SY771
	bool "TP Samsung s6sy771 IC enable or not for OPLUS"
	---help---
	  say Y to enable driver for Touchpanel using Samsung s6sy771
```

## drivers/input/touchscreen/oplus_touchscreen/Samsung/S6SY791/Kconfig
```kconfig
config TOUCHPANEL_SAMSUNG_S6SY791
	bool "TP Samsung s6sy791 IC enable or not for OPLUS"
	---help---
	  say Y to enable driver for Touchpanel using Samsung s6sy791
```

## drivers/input/touchscreen/oplus_touchscreen/Samsung/S6SY792/Kconfig
```kconfig
#ifdef OPLUS_FEATURE_TP_BASIC


config TOUCHPANEL_SAMSUNG_S6SY792
#	default y
	bool "TP Samsung s6sy792 IC enable or not for OPLUS"
	---help---
	say Y to enable driver for Touchpanel using Samsung s6sy792

#endif
```

## drivers/input/touchscreen/oplus_touchscreen/Synaptics/Kconfig
```kconfig
source "drivers/input/touchscreen/oplus_touchscreen/Synaptics/Syna_tcm_oncell/Kconfig"
```

## drivers/input/touchscreen/oplus_touchscreen/Synaptics/S3508/Kconfig
```kconfig
#ifdef OPLUS_FEATURE_TP_BASIC


config TOUCHPANEL_SYNAPTICS_S3508
#	default y
	bool "TP Synaptics_S3508 IC enable or not for OPLUS"
	---help---
	say Y to enable driver for Touchpanel useing synaptics s3508
	
#endif
```

## drivers/input/touchscreen/oplus_touchscreen/Synaptics/TD4320/Kconfig
```kconfig
#
# Synaptics TCM touchscreen driver configuration
#
config TOUCHPANEL_SYNAPTICS_TD4320
	bool "Synaptics TCM touchscreen"
	default n
	help
	  Say Y here if you have a Synaptics TCM touchscreen connected
	  to your system.

	  If unsure, say N.
```

## drivers/input/touchscreen/oplus_touchscreen/Synaptics/TD4320_noflash/Kconfig
```kconfig
#
# Synaptics TCM touchscreen driver configuration
#
config TOUCHPANEL_SYNAPTICS_TD4320_NOFLASH
	bool "Synaptics TCM touchscreen"
	default n
	help
	  Say Y here if you have a Synaptics TCM touchscreen connected
	  to your system.

	  If unsure, say N.

config TOUCHPANEL_SYNAPTICS_TD4330_NOFLASH
	bool "Synaptics TCM touchscreen"
	default n
	help
	  Say Y here if you have a Synaptics TCM touchscreen connected
	  to your system.

	  If unsure, say N.
```

## drivers/input/touchscreen/oplus_touchscreen/ilitek/Kconfig
```kconfig
source "drivers/input/touchscreen/oplus_touchscreen/ilitek/ilitek9881h/Kconfig"
source "drivers/input/touchscreen/oplus_touchscreen/ilitek/ilitek9881h_v2/Kconfig"
source "drivers/input/touchscreen/oplus_touchscreen/ilitek/ilitek9881h_v3/Kconfig"
source "drivers/input/touchscreen/oplus_touchscreen/ilitek/ilitek9882n/Kconfig"
source "drivers/input/touchscreen/oplus_touchscreen/ilitek/ilitek7807s/Kconfig"
```

## drivers/input/touchscreen/oplus_touchscreen/ilitek/ilitek7807s/Kconfig
```kconfig
config TOUCHPANEL_ILITEK_ILITEK7807S
#	default y
	bool "TP ilitek ilitek7807s IC enable or not for  OPLUS"
	---help---
	say Y to enable driver for Touchpanel using ilitek ilitek7807s
```

## drivers/input/touchscreen/oplus_touchscreen/ilitek/ilitek9881h/Kconfig
```kconfig
#ifdef OPLUS_FEATURE_TP_BASIC


config TOUCHPANEL_ILITEK_ILITEK9881H
#	default y
	bool "TP ilitek ilitek9881h IC enable or not for  OPLUS"
	---help---
	say Y to enable driver for Touchpanel using ilitek ilitek9881h

#endif
```

## drivers/input/touchscreen/oplus_touchscreen/ilitek/ilitek9882n/Kconfig
```kconfig
config TOUCHPANEL_ILITEK_ILITEK9882N
#	default y
	bool "TP ilitek ilitek9882n IC enable or not for  OPLUS"
	---help---
	say Y to enable driver for Touchpanel using ilitek ilitek9882n
```

## drivers/misc/aw8697_haptic/Kconfig
```kconfig
config AW8697_HAPTIC
    tristate "Haptic driver for awinic aw8697 series"
    depends on I2C
    help
      This option enables support for aw8697 series Haptic Driver.

config HAPTIC_FEEDBACK
    tristate "Haptic driver feedback for awinic aw8697 series"
    help
      This option enables support for aw8697 series Haptic Driver Feedback.
```

## drivers/power/oplus/Kconfig
```kconfig
menuconfig OPLUS_CHARGER
	bool "OPLUS charging system"
	depends on I2C
	select REGMAP_I2C
	help
	  Say Y here to enable OPLUS charging system support

if OPLUS_CHARGER
config OPLUS_CHARGER_MTK
	bool "OPLUS charger on MTK"
	help
	  Say Y here to declare charging system is on MTK

config OPLUS_CALL_MODE_SUPPORT
	bool "OPLUS call mode support"
	help
	  Say Y to include support

config OPLUS_SMART_CHARGER_SUPPORT
	bool "OPLUS smart charger support"
	help
	  Say Y to include support

config OPLUS_CHG_DYNAMIC_CONFIG
	bool "OPLUS_CHG_DYNAMIC_CONFIG"
	default n
	help
	  Say Y to include support

menuconfig OPLUS_CHG
	tristate "OPLUS CHARGER KO module"
	default n
depends on I2C
	select REGMAP_I2C
	help
	  Enables support for the oplus charging v1 framework

source "drivers/power/oplus/v1/Kconfig"

menuconfig OPLUS_CHG_V2
	tristate "OPLUS charging V2 system"
	default n
	depends on I2C
	select REGMAP_I2C
	help
	  Enables support for the oplus charging v2 framework

if OPLUS_CHG_V2
source "drivers/power/oplus/v2/Kconfig"
endif

endif #OPLUS_CHARGER
```

## drivers/power/oplus/v1/Kconfig
```kconfig
config OPLUS_STANDARD_BATTERY_CHECK_ADC
	bool "OPLUS Official Standard Battery check by ADC"
	help
	  Say Y here to support Official Standard Battery check by ADC

config MTK_DISABLE_GAUGE
	bool "OPLUS MTK disable gauge "
	help
	  Say Y here to include support

config OPLUS_SMOOTH_SOC
	bool "OPLUS config smooth soc "
	help
	  Say Y here to include smooth soc

config OPLUS_CHARGER_WIRELESS_PEN
        bool "OPLUS charger wireless pen"
        help
          Say Y to include support

config OPLUS_MTK_DRM_GKI_NOTIFY_CHG
	default n
	tristate "chg mtk gki notify"

config OPLUS_SM8450_CHARGER
	bool "OPLUS SM8450 charger driver"
	help
	  Enables support for the sm8450 charging
```

## drivers/power/oplus/v2/Kconfig
```kconfig
config OPLUS_CHG_IC_DEBUG
	bool "Virtual IC layer debug interface"
	help
	  Say Y here to declare virtual IC layer debug interface

config OPLUS_CHG_MMS_DEBUG
	bool "Message subscription layer debug interface"
	help
	  Say Y here to declare message subscription layer debug interface

config OPLUS_DA9313_CHARGER
	bool "DA9313 support"
	help
	  Say Y here to declare DA9313 support

config OPLUS_MP2762_CHARGER
	bool "MP2762 support"
	help
	  Say Y here to declare MP2762 support

config OPLUS_SGM41512_CHARGER
	bool "SGM41512 support"
	help
	  Say Y here to declare SGM41512 support

config OPLUS_PD_MANAGER_CHARGER
	bool "PD_MANAGER support"
	help
	  Say Y here to declare PD_MANAGER support

config OPLUS_ADSP_CHARGER
	bool "ADSP support"
	help
	  Say Y here to declare ADSP support

config OPLUS_MT6375_CHARGER
	bool "MT6375 debug support"
	help
	  Say Y here to declare MT6375 debug support
```

## drivers/soc/oplus/Kconfig
```kconfig
#ifdef OPLUS_FEATURE_TP_BASIC
source "drivers/soc/oplus/device_info/Kconfig"
#endif /* OPLUS_FEATURE_TP_BASIC */
#ifdef OPLUS_FEATURE_ESIM
source "drivers/soc/oplus/misc/Kconfig"
#endif /* OPLUS_FEATURE_ESIM */
#ifdef OPLUS_FEATURE_SENSOR_SMEM
source "drivers/soc/oplus/sensor/Kconfig"
#endif /* OPLUS_FEATURE_SENSOR_SMEM */
#ifdef VENDOR_EDIT
source "drivers/soc/oplus/system/Kconfig"
#endif /* VENDOR_EDIT */
#ifdef OPLUS_FEATURE_THERMAL_HORAE
source "drivers/soc/oplus/thermal/Kconfig"
#endif /* OPLUS_FEATURE_THERMAL_HORAE */
```

## drivers/soc/oplus/healthinfo/Kconfig
```kconfig
#ifdef OPLUS_FEATURE_HEALTHINFO
config OPLUS_HEALTHINFO
bool "config healthinfo"
help
    define this config to init  healthinfo.
config MMAP_LOCK_OPT
	bool "config mmap lock opt boos"
	default n
	help
	  reduce sleep time in mmap lock
#endif /* OPLUS_FEATURE_HEALTHINFO */
```

## drivers/soc/oplus/im/Kconfig
```kconfig
config OPLUS_FEATURE_IM
	bool "identify task itself"
	default n
	help
	  In many cases we need to identify task, all we do is simply string compare,
	  but in some performance sensitive context like scheduler, it's not a good choice to
	  do that. So this IM thing can let we check task only through one comparsion.
```

## drivers/soc/oplus/iomonitor/Kconfig
```kconfig
# SPDX-License-Identifier: GPL-2.0-only
# Copyright (C) 2018-2020 Oplus. All rights reserved.

#ifdef OPLUS_FEATURE_IOMONITOR
config IOMONITOR
	bool "Iomonitor module"
	help
		define this config to init iomonitor.

config IOMONITOR_WITH_F2FS
	bool "Filesystem is f2fs"
	depends on IOMONITOR
	help
		define this config to support both f2fs and ext4
#endif /*OPLUS_FEATURE_IOMONITOR*/
```

## drivers/soc/oplus/lowmem_dbg/Kconfig
```kconfig
# SPDX-License-Identifier: GPL-2.0-only
# Copyright (C) 2018-2020 Oplus. All rights reserved.

config OPLUS_FEATURE_LOWMEM_DBG
        bool "OPLUS Low Memory debug"
        default n
        help
          print memory usage when low mem occurs.
```

## drivers/soc/oplus/midas/Kconfig
```kconfig
# SPDX-License-Identifier: GPL-2.0-only
# Copyright (C) 2018-2020 Oplus. All rights reserved.

config OPLUS_FEATURE_MIDAS
bool "config oplus midas device feature"
help
	This selects midas device driver

config OPLUS_FEATURE_BINDER_STATS_ENABLE
bool "config oplus midas binder stats feature"
help
	This selects midas binder stats device driver

config OPLUS_FEATURE_SET_ALL_VPU_LATENCY
bool "config oplus midas vpu power off latency setting feature"
help
	This selects midas vpu power off latency setting driver

config OPLUS_FEATURE_DISPCAP
bool "config oplus midas dispcap feature"
help
	This selects midas dispcap device driver
```
