## drivers/soc/oplus/misc/Kconfig
```kconfig
# SPDX-License-Identifier: GPL-2.0-only
# Copyright (C) 2018-2020 Oplus. All rights reserved.

#ifdef OPLUS_FEATURE_ESIM
source "drivers/soc/oplus/misc/oplus_gpio/Kconfig"
#endif /* OPLUS_FEATURE_ESIM */
```

## drivers/soc/oplus/oplus_nandswap/Kconfig
```kconfig
config NANDSWAP
	bool "nandswap feature"
	default n
	help
	 nandswap feature

config NANDSWAP_DEBUG
	bool "nandswap debug"
	depends on F2FS_FS
	default n
	help
	 nandswap debug
```

## drivers/soc/oplus/owakelock/Kconfig
```kconfig
#ifdef OPLUS_FEATURE_POWERINFO_STANDBY
config OPLUS_WAKELOCK_PROFILER
bool "config wakelock profiler"
help
    Select this config to enable wakelock profiler

config OPLUS_POWER_QCOM
bool "QCOM Config"
help
    Select this config to enable wakelock profiler

config OPLUS_POWER_MTK
bool "MTK Config"
help
    Select this config to enable wakelock profiler
#endif /* OPLUS_FEATURE_POWERINFO_STANDBY */

#ifdef OPLUS_FEATURE_POWERINFO_STANDBY_DEBUG
config OPLUS_POWERINFO_STANDBY_DEBUG
bool "powerinfo standby config"
default n
help
    Select this config to enable powerinfo standby debug
#endif /* OPLUS_FEATURE_POWERINFO_STANDBY_DEBUG */

#ifdef OPLUS_FEATURE_POWERINFO_RPMH
config OPLUS_POWERINFO_RPMH
bool "powerinfo rpmh config"
default n
help
    Select this config to enable powerinfo rpmh
#endif /* OPLUS_FEATURE_POWERINFO_RPMH */

#ifdef OPLUS_FEATURE_POWERINFO_FTM
config OPLUS_POWERINFO_FTM
bool "powerinfo ftm config"
default n
help
    Select this config to enable powerinfo ftm
#endif /* OPLUS_FEATURE_POWERINFO_FTM */
```

## drivers/soc/oplus/svelte/Kconfig
```kconfig
# SPDX-License-Identifier: GPL-2.0-only
# Copyright (C) 2018-2020 Oplus. All rights reserved.

config SVELTE
	tristate "svelte log driver"
	default n
	---help---
	  Log reading and writing is performed via normal Linux reads and
	  optimized writes. This optimization avoids logging having too
	  much overhead in the system.
```

## drivers/soc/oplus/system/Kconfig
```kconfig
# SPDX-License-Identifier: GPL-2.0-only
# Copyright (C) 2018-2020 Oplus. All rights reserved.
config OPLUS_SYSTEM_KERNEL
	bool "config oplus system feature "
	default y
	help
	  define this config to add oplus sytstem kernel feature

source "drivers/soc/oplus/system/oplus_project/Kconfig"
source "drivers/soc/oplus/system/project_info/Kconfig"
source "drivers/soc/oplus/system/mdmrst/Kconfig"
```

## drivers/soc/oplus/system/acm/Kconfig
```kconfig
config OPLUS_FEATURE_ACM
	bool "Enable Access Control Module"
	depends on OPLUS_SYSTEM_KERNEL
	default n
	---help---
	  Access Control Module device driver. The purpose of this module
	  is to prevent third-party apps from deleting media files illegally.
	  This module maintains a white list of apps. Apps in the whitelist
	  can delete media file without any constrains, while apps not int
	  the whitelist may not able to delete media files, instead, the files
	  to be deleted were moved to the recycle directory by Gallery.

config OPLUS_FEATURE_ACM_LOGGING
	bool "Enable ACM logging features"
	depends on OPLUS_FEATURE_ACM
	default n
	---help---
	  Enable logging features for ACM. Report delete information to Quality.
```

## drivers/soc/oplus/system/dump_device_info/Kconfig
```kconfig
# SPDX-License-Identifier: GPL-2.0-only
# Copyright (C) 2018-2020 Oplus. All rights reserved.
config OPLUS_FEATURE_DUMP_DEVICE_INFO
  bool "config dump device info"
  default n
  help
	define this config to  dump device info.
```

## drivers/soc/oplus/system/dump_reason/Kconfig
```kconfig
# SPDX-License-Identifier: GPL-2.0-only
# Copyright (C) 2018-2020 Oplus. All rights reserved.
config OPLUS_FEATURE_DUMP_REASON
  bool "config oplus dump reason"
  default n
  help
	define this config to dump reason.
```

## drivers/soc/oplus/system/feedback/Kconfig
```kconfig
# SPDX-License-Identifier: GPL-2.0-only
# Copyright (C) 2018-2020 Oplus. All rights reserved.
config OPLUS_FEATURE_FEEDBACK
  tristate "Oplus system feedback"
  default n
  depends on OPLUS_SYSTEM_KERNEL
  help
    define this config to init oplus system feedback.
```

## drivers/soc/oplus/system/hung_task_enhance/Kconfig
```kconfig
# SPDX-License-Identifier: GPL-2.0-only
# Copyright (C) 2018-2020 Oplus. All rights reserved.
config OPLUS_FEATURE_HUNG_TASK_ENHANCE
	bool "system hung task enhance"
	default n
	depends on DETECT_HUNG_TASK
	depends on OPLUS_SYSTEM_KERNEL
	help
      define this config to enable QCOM platform uboot log .

config OPLUS_FEATURE_DEATH_HEALER
	bool "Enable DeathHealer"
	depends on DETECT_HUNG_TASK
	depends on OPLUS_FEATURE_HUNG_TASK_ENHANCE
	default y
	help
	  define this config to enable DEATH_HEALER .
```

## drivers/soc/oplus/system/mdmfeature/Kconfig
```kconfig
# SPDX-License-Identifier: GPL-2.0-only
# Copyright (C) 2018-2020 Oplus. All rights reserved.
config OPLUS_FEATURE_MDMFEATURE
  tristate "config modify modem feature"
  default n
  help
    define this config to modify modem feature.
```

## drivers/soc/oplus/system/mdmrst/Kconfig
```kconfig
# SPDX-License-Identifier: GPL-2.0-only
# Copyright (C) 2018-2020 Oplus. All rights reserved.
config OPLUS_FEATURE_RECORD_MDMRST
bool "config record mdmrst"
help
    define this config to count the modem restart times.
```

## drivers/soc/oplus/system/olc/Kconfig
```kconfig
# SPDX-License-Identifier: GPL-2.0-only
# Copyright (C) 2020-2022 Oplus. All rights reserved.

config OPLUS_FEATURE_OLC
        tristate "Add for oplus log core"
        default n
        help
          Add for oplus log core.
```

## drivers/soc/oplus/system/oplus_fdleak/Kconfig
```kconfig
# SPDX-License-Identifier: GPL-2.0-only
# Copyright (C) 2022-2025 Oplus. All rights reserved.
config OPLUS_FEATURE_FDLEAK_CHECK
    tristate "fdleak check"
    default n
    depends on OPLUS_SYSTEM_KERNEL
    help
      general utility to detect fdleak for userspace key process.
```

## drivers/soc/oplus/system/oplus_midas/Kconfig
```kconfig
# SPDX-License-Identifier: GPL-2.0-only
# Copyright (C) 2018-2020 Oplus. All rights reserved.

#ifdef OPLUS_FEATURE_MIDAS
config OPLUS_FEATURE_MIDAS
bool "config oplus midas feature"
help
	This selects midas driver
#endif /*OPLUS_FEATURE_MIDAS*/
```

## drivers/soc/oplus/system/oplus_mm_fb/Kconfig
```kconfig
config OPLUS_FEATURE_MM_FEEDBACK
  bool "Oplus multimedia kevent feedback"
  default n
  help
    define this config to init oplus multimedia kevent feedback driver
```

## drivers/soc/oplus/system/oplus_phoenix/Kconfig
```kconfig
# SPDX-License-Identifier: GPL-2.0-only
# Copyright (C) 2018-2020 Oplus. All rights reserved.
#change 'y' to 'n', if you want fo close phoenix feature
config OPLUS_FEATURE_PHOENIX
    bool "oplus phoenix project"
    default n
    help
      define this config to init oplus phoenix project.

config OPLUS_FEATURE_KMSG_WB
    tristate "oplus phoenix2.0 project"
    default n
    help
      define this config to init oplus phoenix2.0 project.

config OPLUS_FEATURE_PHOENIX_REBOOT_SPEED
    tristate "oplus phoenix project"
    default n
    help
      define this config to init oplus phoenix project.
```

## drivers/soc/oplus/system/oplus_pmic_monitor/Kconfig
```kconfig
# SPDX-License-Identifier: GPL-2.0-only
# Copyright (C) 2018-2020 Oplus. All rights reserved.
#change 'y' to 'n', if you want fo close pmic monitor
config OPLUS_FEATURE_PMIC_MONITOR
    tristate "oplus pmic monitor"
    default n
    help
      define this config to init oplus pmic monitor.
```

## drivers/soc/oplus/system/qcom_minidump/Kconfig
```kconfig
# SPDX-License-Identifier: GPL-2.0-only
# Copyright (C) 2018-2020 Oplus. All rights reserved.
config OPLUS_FEATURE_QCOM_MINIDUMP_ENHANCE
	 bool "qcom minidump enhance"
	default n
	depends on OPLUS_SYSTEM_KERNEL
	help
            define this config to enable qcom minidump enhance.
```

## drivers/soc/oplus/system/qcom_pmicwd/Kconfig
```kconfig
# SPDX-License-Identifier: GPL-2.0-only
# Copyright (C) 2018-2020 Oplus. All rights reserved.
config OPLUS_FEATURE_QCOM_PMICWD
	tristate "qcom pmic watchdog"
	default n
	depends on OPLUS_SYSTEM_KERNEL
	help
            define this config to enable qcom pmic watchdog.
			export pwk dump interface to android for control pwkdump.
```

## drivers/soc/oplus/system/qcom_watchdog/Kconfig
```kconfig
# SPDX-License-Identifier: GPL-2.0-only
# Copyright (C) 2018-2020 Oplus. All rights reserved.
config OPLUS_FEATURE_QCOM_WATCHDOG
	tristate "qcom watchdog"
	default n
	depends on OPLUS_SYSTEM_KERNEL
	help
            enhance the qcom watchdog.
```

## drivers/soc/oplus/system/selinux/Kconfig
```kconfig
# SPDX-License-Identifier: GPL-2.0-only
# Copyright (C) 2018-2020 Oplus. All rights reserved.

config OPLUS_FEATURE_SELINUX_CONTROL_LOG
  bool "config control selinux log"
  default y
  help
	define this config to control selinux log.
```

## drivers/soc/oplus/system/shutdown_detect/Kconfig
```kconfig
# SPDX-License-Identifier: GPL-2.0-only
# Copyright (C) 2018-2020 Oplus. All rights reserved.
config OPLUS_FEATURE_SHUTDOWN_DETECT
	tristate "shutdown hang detect"
	default n
	depends on OPLUS_SYSTEM_KERNEL
	help
            define this config to enable shutdown_detect.
```

## drivers/soc/oplus/system/slabtrace/Kconfig
```kconfig
# SPDX-License-Identifier: GPL-2.0-only
# Copyright (C) 2018-2020 Oplus. All rights reserved.
config OPLUS_FEATURE_SLABTRACE_DEBUG
	bool "SLABTRACE debugging on by default"
	depends on SLUB && SLUB_DEBUG
#	default y
	default n
	help
	  Boot with debugging on by default. SLUB boots by default with
	  the runtime debug capabilities switched off. Add for check
	  common kmalloc caches memleak.
```

## drivers/soc/oplus/system/theia/Kconfig
```kconfig
# SPDX-License-Identifier: GPL-2.0-only
# Copyright (C) 2018-2020 Oplus. All rights reserved.
#change 'y' to 'n', if you want fo close theia feature
config OPLUS_FEATURE_THEIA
    tristate "theia project"
    default n
    help
      define this config to init theia project.
```
